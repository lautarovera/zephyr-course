## led_sensor_module/drivers/led_sensor/Kconfig
```kconfig
config LED_SENSOR
    bool "LED sensor driver"
    default y
    depends on DT_HAS_LV_LED_SENSOR_ENABLED
    depends on SENSOR
    select GPIO
    help
      Enable the LED sensor driver: an LED on a GPIO pin exposed
      through the sensor API.
```

## led_sensor_module/dts/bindings/sensor/lv,led-sensor.yml
```yaml
description: LED exposed through the sensor API
compatible: "lv,led-sensor"

properties:
  led:
    type: phandle
    required: true
```
