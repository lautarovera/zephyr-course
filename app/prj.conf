## CMakeLists.txt
```
cmake_minimum_required(VERSION 3.20.0)

list(APPEND BOARD_ROOT ${CMAKE_CURRENT_SOURCE_DIR}/..)

find_package(Zephyr REQUIRED)
project(my_zephyr_app)

target_sources(app PRIVATE src/main.cpp src/led_sensor_shell.c)
```

## Kconfig
```
menu "Demo Application"

config APP_BLINKY_ENABLED
	bool "Enable application blinky"

choice APP_LOG_VERBOSITY
	prompt "App log verbosity"
	default APP_LOG_VERBOSITY_INF

config APP_LOG_VERBOSITY_DBG
	bool "Debug"

config APP_LOG_VERBOSITY_INF
	bool "Info"

config APP_LOG_VERBOSITY_WEN
	bool "Warning"

endchoice

endmenu

menuconfig LED_SUBSYSTEM
	bool "LED Subsystem"
	default y

if LED_SUBSYSTEM

choice LED_BLINK_SLEEP
	prompt "LED blink sleep time"
	default LED_BLINK_SLEEP_MEDIUM

config LED_BLINK_SLEEP_FAST
	bool "500ms (fast)"

config LED_BLINK_SLEEP_MEDIUM
	bool "1s (medium)"

config LED_BLINK_SLEEP_SLOW
	bool "2s (slow)"

endchoice

config LED_BLINK_SLEEP_MS
	int
	default 500 if LED_BLINK_SLEEP_FAST
	default 1000 if LED_BLINK_SLEEP_MEDIUM
	default 2000 if LED_BLINK_SLEEP_SLOW

menuconfig LED_ADVANCED
	bool "Advanced LED settings"
	default n

if LED_ADVANCED

config LED_BRIGHTNESS
	int "LED brightness (0-100)"
	default 100
	range 0 100

config LED_FADE_DURATION
	int "LED fade duration (ms)"
	default 500
	range 0 5000

menu "Expert settings"

config LED_DEBUG
	bool "Enable LED debugging"
	default n

config LED_CUSTOM_BLINK
	bool "Custom blink pattern"
	default n

endmenu

endif # LED_ADVANCED

endif # LED_SUBSYSTEM

rsource "Kconfig.heartbeat"

source "Kconfig.zephyr"
```

## prj.conf
```kconfig
CONFIG_GPIO=y
CONFIG_LOG=y
CONFIG_SENSOR=y
CONFIG_SHELL=y
```

## app.overlay
```dts
/ {
    aliases {
        app-led = &red_led;
    };

    led_sensor0: led_sensor {
        compatible = "lv,led-sensor";
        led = <&green_led>;
        status = "okay";
    };
};
```

## src/main.cpp
```c
#include <zephyr/device.h>
#include <zephyr/kernel.h>
#include <zephyr/logging/log.h>

LOG_MODULE_REGISTER(main, LOG_LEVEL_INF);

static const struct device *const led_sensor = DEVICE_DT_GET_ANY(lv_led_sensor);

int main(void)
{
    if (!device_is_ready(led_sensor)) {
        LOG_ERR("LED sensor not ready");
        return 0;
    }

    LOG_INF("%s ready, use the 'sensor' shell command", led_sensor->name);
    return 0;
}
```

## src/led_sensor_shell.c
```c
/*
 * Shell commands for the LED sensor driver
 */

#include <errno.h>
#include <zephyr/device.h>
#include <zephyr/drivers/sensor.h>
#include <zephyr/shell/shell.h>

#include <led_sensor/led_sensor.h>

static const struct device *const led_sensor = DEVICE_DT_GET_ANY(lv_led_sensor);

/* Valid values for "sensor set": 0 = normal, 1 = inverted. */
#define SET_VALUE_MIN 0
#define SET_VALUE_MAX 1

static bool sensor_is_ready(const struct shell *sh)
{
    if (!device_is_ready(led_sensor)) {
        shell_error(sh, "LED sensor not ready");
        return false;
    }

    return true;
}

static int cmd_sensor_fetch(const struct shell *sh, size_t argc, char **argv)
{
    ARG_UNUSED(argc);
    ARG_UNUSED(argv);

    if (!sensor_is_ready(sh)) {
        return -ENODEV;
    }

    int ret = sensor_sample_fetch(led_sensor);

    if (ret < 0) {
        shell_error(sh, "sensor_sample_fetch failed (%d)", ret);
        return ret;
    }

    shell_print(sh, "Sample fetched");
    return 0;
}

static int cmd_sensor_read(const struct shell *sh, size_t argc, char **argv)
{
    ARG_UNUSED(argc);
    ARG_UNUSED(argv);

    if (!sensor_is_ready(sh)) {
        return -ENODEV;
    }

    struct sensor_value val;
    int ret = sensor_channel_get(led_sensor, (enum sensor_channel)SENSOR_CHAN_LED_STATE, &val);

    if (ret < 0) {
        shell_error(sh, "sensor_channel_get failed (%d)", ret);
        return ret;
    }

    shell_print(sh, "LED state after last fetch: %d", val.val1);
    return 0;
}

static int cmd_sensor_info(const struct shell *sh, size_t argc, char **argv)
{
    ARG_UNUSED(argc);
    ARG_UNUSED(argv);

    if (led_sensor == NULL) {
        shell_error(sh, "No lv,led-sensor node in the devicetree");
        return -ENODEV;
    }

    shell_print(sh, "Device: %s", led_sensor->name);
    shell_print(sh, "Ready:  %s", device_is_ready(led_sensor) ? "yes" : "no");
    return 0;
}

static int cmd_sensor_set(const struct shell *sh, size_t argc, char **argv)
{
    ARG_UNUSED(argc);

    int err = 0;
    long value = shell_strtol(argv[1], 10, &err);

    if (err != 0 || value < SET_VALUE_MIN || value > SET_VALUE_MAX) {
        shell_error(sh, "Invalid value '%s': expected %d (normal) or %d (inverted)",
                    argv[1], SET_VALUE_MIN, SET_VALUE_MAX);
        return -EINVAL;
    }

    if (!sensor_is_ready(sh)) {
        return -ENODEV;
    }

    int ret = led_sensor_set_inverted(led_sensor, value == SET_VALUE_MAX);

    if (ret < 0) {
        shell_error(sh, "led_sensor_set_inverted failed (%d)", ret);
        return ret;
    }

    shell_print(sh, "Inverted mode: %s", value == SET_VALUE_MAX ? "ON" : "OFF");
    return 0;
}

SHELL_STATIC_SUBCMD_SET_CREATE(sub_sensor,
    SHELL_CMD(fetch, NULL, "Fetch a sample (sensor_sample_fetch).", cmd_sensor_fetch),
    SHELL_CMD(read, NULL, "Read the LED state channel (sensor_channel_get).", cmd_sensor_read),
    SHELL_CMD(info, NULL, "Show device name and ready state.", cmd_sensor_info),
    SHELL_CMD_ARG(set, NULL, "Set inverted mode: set <0|1>.", cmd_sensor_set, 2, 0),
    SHELL_SUBCMD_SET_END
);

SHELL_CMD_REGISTER(sensor, &sub_sensor, "LED sensor commands", NULL);
```
